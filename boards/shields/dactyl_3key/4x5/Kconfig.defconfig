## boards/shields/dactyl_3key/4x5/Kconfig.defconfig
```kconfig
if SHIELD_DACTYL_3KEY_4x5_LEFT

config ZMK_KEYBOARD_NAME
	default "K33B Dactyl 4x5"
config ZMK_SPLIT_ROLE_CENTRAL
	default y

endif

if SHIELD_DACTYL_3KEY_4x5_RIGHT

config ZMK_SPLIT_ROLE_CENTRAL
	default n

endif


if SHIELD_DACTYL_3KEY_4x5_LEFT || SHIELD_DACTYL_3KEY_4x5_RIGHT

config ZMK_SPLIT
	default y

endif
```

## boards/shields/dactyl_3key/4x5/Kconfig.shield
```kconfig
config SHIELD_DACTYL_3KEY_4x5_LEFT
	def_bool $(shields_list_contains,dactyl_3key_4x5_left)

config SHIELD_DACTYL_3KEY_4x5_RIGHT
	def_bool $(shields_list_contains,dactyl_3key_4x5_right) 
```

## boards/shields/k33b_dactyl_3key_4x5/Kconfig.shield
```kconfig
config SHIELD_K33B_DACTYL_3KEY_4x5_LEFT
	def_bool $(shields_list_contains,k33b_dactyl_3key_4x5_left)

config SHIELD_K33B_DACTYL_3KEY_4x5_RIGHT
	def_bool $(shields_list_contains,k33b_dactyl_3key_4x5_right) 
```
